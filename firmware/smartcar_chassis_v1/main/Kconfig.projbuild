## firmware/smartcar_chassis_v1/main/Kconfig.projbuild
```kconfig
menu "Smartcar chassis"

config MICRO_ROS_APP_STACK
    int "micro-ROS task stack (bytes)"
    range 12000 32000
    default 18000

config MICRO_ROS_APP_TASK_PRIO
    int "micro-ROS task priority"
    range 1 19
    default 8

choice SMARTCAR_CHASSIS_MODE
    prompt "Chassis communication mode"
    default SMARTCAR_CHASSIS_MICROROS_UDP

config SMARTCAR_CHASSIS_MICROROS_UDP
    bool "micro-ROS over Wi-Fi UDP"

config SMARTCAR_CHASSIS_MICROROS_SERIAL
    bool "micro-ROS over USB serial"
    help
        Use UART0 exclusively for micro-ROS XRCE-DDS. Disable the serial CLI and
        JSON console because both share the ESP32 USB-UART connection.

config SMARTCAR_CHASSIS_CONSOLE
    bool "Serial diagnostic console"
endchoice

config SMARTCAR_WIFI_SSID
    string "2.4 GHz Wi-Fi SSID"
    depends on SMARTCAR_CHASSIS_MICROROS_UDP
    default "Mifi_049"

config SMARTCAR_WIFI_PASSWORD
    string "Wi-Fi password (local sdkconfig only)"
    depends on SMARTCAR_CHASSIS_MICROROS_UDP
    default ""

config SMARTCAR_AUTO_DISCOVERY
    bool
    depends on SMARTCAR_CHASSIS_MICROROS_UDP
    default y

config SMARTCAR_DISCOVERY_PORT
    int "Chassis discovery UDP port"
    depends on SMARTCAR_CHASSIS_MICROROS_UDP
    range 1024 65535
    default 8892

config SMARTCAR_SYNC_PORT
    int "Agent UDP port advertised in discovery"
    depends on SMARTCAR_CHASSIS_MICROROS_UDP
    range 1024 65535
    default 8891

endmenu
```

## firmware/smartcar_chassis_v1/sdkconfig.defaults
```kconfig
CONFIG_IDF_TARGET="esp32"
CONFIG_ESPTOOLPY_FLASHSIZE_4MB=y
CONFIG_ESPTOOLPY_FLASHMODE_DIO=y
CONFIG_FREERTOS_HZ=1000
CONFIG_COMPILER_OPTIMIZATION_PERF=y
CONFIG_GPTIMER_ISR_IRAM_SAFE=y
CONFIG_ESP_MAIN_TASK_STACK_SIZE=4096
CONFIG_ESP_TASK_WDT_INIT=n
CONFIG_ESP_CONSOLE_NONE=y
CONFIG_LOG_DEFAULT_LEVEL_NONE=y
CONFIG_BOOTLOADER_LOG_LEVEL_NONE=y
CONFIG_MICRO_ROS_ESP_XRCE_DDS_MIDDLEWARE=y
CONFIG_MICRO_ROS_ESP_UART_TRANSPORT=y
CONFIG_MICROROS_UART_TXD=-1
CONFIG_MICROROS_UART_RXD=-1
CONFIG_MICROROS_UART_RTS=-1
CONFIG_MICROROS_UART_CTS=-1
CONFIG_MICRO_ROS_APP_STACK=18000
CONFIG_MICRO_ROS_APP_TASK_PRIO=8
CONFIG_SMARTCAR_CHASSIS_MICROROS_SERIAL=y
```

## thirdparty/smartcar_udp_heartbeat/firmware/main/Kconfig.projbuild
```kconfig
menu "Smartcar UDP Heartbeat"

    config SMARTCAR_WIFI_SSID
        string "Wi-Fi SSID"
        default ""
        help
            Name of the 2.4 GHz Wi-Fi network. Configure this locally.

    config SMARTCAR_WIFI_PASSWORD
        string "Wi-Fi password"
        default ""
        help
            Configure this locally. The application never logs this password.
            Leave empty only for an open network.

    config SMARTCAR_AUTO_DISCOVERY
        bool "Discover and subscribe from the receiver (no fixed host IP)"
        default y
        help
            The S3 joins Wi-Fi and waits for a computer to discover and subscribe.
            Sensor data is sent only to the active subscriber, learned from its
            source IP and requested data port. Disable for legacy static routing.

    config SMARTCAR_DISCOVERY_PORT
        int "S3 UDP discovery and subscription port"
        range 1024 65535
        default 8890

    config SMARTCAR_HOST_IPV4
        string "Legacy static receiver IPv4 (ignored during auto discovery)"
        default "192.168.1.100"
        help
            Used only when automatic discovery is disabled.
            Reachable LAN IPv4 address of the receiver.
            Do not use 127.0.0.1, the router address, or the ESP32 address.

    config SMARTCAR_HOST_PORT
        int "Receiver UDP data port"
        range 1024 65535
        default 8888

    config SMARTCAR_SYNC_PORT
        int "S3 UDP clock synchronization port"
        range 1024 65535
        default 8889

    config SMARTCAR_IMU_ENABLE
        bool "Enable MPU6050 50 Hz acquisition and UDP"
        default y

    config SMARTCAR_IMU_SCL_GPIO
        int "MPU6050 SCL GPIO"
        depends on SMARTCAR_IMU_ENABLE
        range 0 48
        default 21

    config SMARTCAR_IMU_SDA_GPIO
        int "MPU6050 SDA GPIO"
        depends on SMARTCAR_IMU_ENABLE
        range 0 48
        default 47

    config SMARTCAR_LIDAR_ENABLE
        bool "Enable X3PRO UART receive diagnostics"
        default y

    config SMARTCAR_LIDAR_RX_GPIO
        int "X3PRO receive GPIO (radar Tx connects here)"
        depends on SMARTCAR_LIDAR_ENABLE
        range 0 48
        default 44
        help
            This installation has confirmed radar Tx to GPIO44 and common GND.
            The receive peripheral is UART1; logs remain on native USB.
            Do not use GPIO19/20 (USB) or GPIO35/36/37 (N16R8 PSRAM).

    config SMARTCAR_LIDAR_BAUD
        int "X3PRO UART baud rate"
        depends on SMARTCAR_LIDAR_ENABLE
        range 1200 921600
        default 115200

endmenu
```

## thirdparty/smartcar_udp_heartbeat/firmware/sdkconfig.defaults
```kconfig
CONFIG_IDF_TARGET="esp32s3"
CONFIG_ESPTOOLPY_FLASHSIZE_16MB=y
CONFIG_ESPTOOLPY_FLASHMODE_DIO=y
CONFIG_ESP_CONSOLE_USB_SERIAL_JTAG=y
CONFIG_SMARTCAR_HOST_PORT=8888
```
